## conf/layer.conf
```bitbake
# We have a conf and classes directory, add to BBPATH
BBPATH .= ":${LAYERDIR}"

# We have recipes-* directories, add to BBFILES
BBFILES += "${LAYERDIR}/recipes-*/*/*.bb \
            ${LAYERDIR}/recipes-*/*/*.bbappend"

BBFILE_COLLECTIONS += "meta-st-x-linux-azure"
BBFILE_PATTERN_meta-st-x-linux-azure = "^${LAYERDIR}/"
BBFILE_PRIORITY_meta-st-x-linux-azure = "6"

LAYERDEPENDS_meta-st-x-linux-azure = "core meta-iotedge"
LAYERSERIES_COMPAT_meta-st-x-linux-azure = "scarthgap"

# OpenSTLinux compatibility version
ST_OSTL_COMPATIBILITY_VERSION_meta-st-x-linux-aws = "6.0"

DISTRO_FEATURES:append = " security"
DISTRO_FEATURES:append = " tpm2"
DISTRO_FEATURES:append = " seccomp"
DISTRO_FEATURES:append = " virtualization"
DISTRO_FEATURES:append = " systemd"
DISTRO_FEATURES:append = " filesystems"
VIRTUAL-RUNTIME_init_manager = "systemd"
VIRTUAL-RUNTIME_initscripts = "systemd-compat-units"
```
